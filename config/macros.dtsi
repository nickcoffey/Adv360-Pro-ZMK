macro_mac_desk_right: macro_mac_desk_right {
  compatible = "zmk,behavior-macro";
  label = "macro_mac_desk_right";
  #binding-cells = <0>;
  bindings = <&kt LCTRL>, <&kt LSHIFT>, <&kp RIGHT_ARROW>, <&kt LCTRL>, <&kt LSHIFT>;
};
macro_mac_desk_left: macro_mac_desk_left {
  compatible = "zmk,behavior-macro";
  label = "macro_mac_desk_left";
  #binding-cells = <0>;
  bindings = <&kt LCTRL>, <&kt LSHIFT>, <&kp LEFT_ARROW>, <&kt LCTRL>, <&kt LSHIFT>;
};
macro_win_desk_left: macro_win_desk_left {
  compatible = "zmk,behavior-macro";
  label = "macro_win_desk_left";
  #binding-cells = <0>;
  bindings = <&kt LCTRL>, <&kt LEFT_GUI>, <&kp LEFT_ARROW>, <&kt LCTRL>, <&kt LEFT_GUI>;
};
macro_win_desk_right: macro_win_desk_right {
  compatible = "zmk,behavior-macro";
  label = "macro_win_desk_right";
  #binding-cells = <0>;
  bindings = <&kt LCTRL>, <&kt LEFT_GUI>, <&kp RIGHT_ARROW>, <&kt LCTRL>, <&kt LEFT_GUI>;
};
